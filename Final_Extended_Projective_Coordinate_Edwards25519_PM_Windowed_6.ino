#include <Arduino.h>
#include <avr/io.h>
#include <stdlib.h>
#include <avr/pgmspace.h>

#define add Ed25519_add
#define sub Ed25519_sub
#define modulo Ed25519_modulo

typedef struct { unsigned char Ed[32]; } field_element;

extern "C"
{
  void sub(field_element *r, const field_element *x, const field_element *y);
  void add(field_element *r, const field_element *x, const field_element *y);
  void modulo(field_element *r, unsigned char *C);
  char Ed_num_sub_prime(unsigned char* r, const unsigned char* a);
  char Ed25519_square(unsigned char* r, const unsigned char* a);
  char Ed_mul(unsigned char* r, const unsigned char* a, const unsigned char* b);
  unsigned char scalar_sub_halforder(unsigned char* r, const unsigned char* a);
  unsigned char scalar_sub_order(unsigned char* r, const unsigned char* a);
  char Ed255_subp_bigint(unsigned char* r, const unsigned char* a);
}

void in_range(field_element *r);
void Ed25519_scalar_sub_order(field_element *r);
void flip_if(field_element *r, const field_element *x, unsigned char b);
void mul(field_element *r, const field_element *x, const field_element *y);
void square(field_element *r, const field_element *x);
void M_Inverse_Z(field_element *r, const field_element *x);

static const field_element PRECOMPUTED_POINTS[65][4] PROGMEM = {
  {{0x00, 0x00, 0x00, 0x00,	0x00, 0x00, 0x00, 0x00,	0x00, 0x00, 0x00, 0x00,	0x00, 0x00, 0x00, 0x00, 0x00, 0x00, 0x00, 0x00,	0x00, 0x00, 0x00, 0x00,	0x00, 0x00, 0x00, 0x00,	0x00, 0x00, 0x00, 0x00},
   {0x01, 0x00, 0x00, 0x00,	0x00, 0x00, 0x00, 0x00,	0x00, 0x00, 0x00, 0x00,	0x00, 0x00, 0x00, 0x00, 0x00, 0x00, 0x00, 0x00,	0x00, 0x00, 0x00, 0x00,	0x00, 0x00, 0x00, 0x00,	0x00, 0x00, 0x00, 0x00},
   {0x00, 0x00, 0x00, 0x00,	0x00, 0x00, 0x00, 0x00,	0x00, 0x00, 0x00, 0x00,	0x00, 0x00, 0x00, 0x00, 0x00, 0x00, 0x00, 0x00,	0x00, 0x00, 0x00, 0x00,	0x00, 0x00, 0x00, 0x00,	0x00, 0x00, 0x00, 0x00},
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   {0xC9, 0xAE, 0x03, 0xB2, 0x72, 0x30, 0xE9, 0xEA, 0xC0, 0x66, 0x50, 0x00, 0x80, 0xD7, 0xBC, 0xB1, 0x48, 0xCF, 0xD3, 0x78, 0xA1, 0x47, 0x02, 0x33, 0x90, 0x49, 0xEC, 0x70, 0x3B, 0xF1, 0x67, 0x29}},
};

field_element prime = {{0xED, 0xFF, 0xFF, 0xFF, 0xFF, 0xFF, 0xFF, 0xFF, 0xFF, 0xFF, 0xFF, 0xFF, 0xFF, 0xFF, 0xFF, 0xFF, 0xFF, 0xFF, 0xFF, 0xFF, 0xFF, 0xFF, 0xFF, 0xFF, 0xFF, 0xFF, 0xFF, 0xFF, 0xFF, 0xFF, 0xFF, 0x7F}};
field_element xr, yr, tr, zr;

volatile unsigned long overflow_count = 0;
ISR(TIMER1_OVF_vect) {overflow_count++;}

int main()
{
  Serial.begin(500000);
  Serial.println();

  //Example scalar (saved using little endian in hex 32 byte array) 3618502788666131106986593281521497120428558180689953803000975469142727125494 = 0x80000000000000000000000000000000a6f7cfbf0a86b3b727e1f776e7ae9f6
  unsigned char scalar[32] = {0xF6,	0xE9,	0x7A,	0x6E,	0x77,	0x1F,	0x7E,	0x72,	0x3B,	0x6B,	0xA8,	0xF0,	0xFB,	0x7C,	0x6F,	0x0A,	0x00,	0x00,	0x00,	0x00,	0x00,	0x00,	0x00,	0x00,	0x00,	0x00,	0x00,	0x00,	0x00,	0x00,	0x00,	0x08};
  field_element temp_scalar, xr, yr, tr, zr, Gx, Gy, Gt, Gz;

  cli();
  TCCR1A = 0;
  TCCR1B = bit(CS10);
  TCNT1 = 0;
  overflow_count = 0;

  TIMSK1 |= (1 << TOIE1);
  sei();

  scalar[0] &= 248;
  scalar[31] &= 127;
  scalar[31] |= 64;

  for (int i = 0; i < 32; i++){temp_scalar.Ed[i] = scalar[i];}
  for (int i = 0; i < 7; i++){Ed25519_scalar_sub_order(&temp_scalar);}
  for (int i = 0; i < 32; i++){scalar[i] = temp_scalar.Ed[i];}

  windowed_scalar_mul(&Gx, &Gy, &Gt, &Gz, scalar, PRECOMPUTED_POINTS);

  cli();
  unsigned long final_cycles = TCNT1;
  sei();

  unsigned long total_cycles = (overflow_count * 65536UL) + final_cycles;

  Serial.print("Number of cycles = ");
  Serial.println(total_cycles);

  Serial.print("Time requirement = ");
  Serial.print((float)total_cycles / 16);
  Serial.println(" Microseconds");

  Serial.print("Time requirement = ");
  Serial.print((float)total_cycles / 16000);
  Serial.println(" Millisecond");

  Serial.print("Time requirement = ");
  Serial.print((float)total_cycles / 16000000);
  Serial.println(" second");
  
  Serial.print("Affine x-coordinate: ");
  for (int i = 0; i < 32; i++)
  {
    Serial.print(Gx.Ed[i], HEX);
  }
  Serial.println();
}

void windowed_scalar_mul(field_element *xr, field_element *yr, field_element *tr, field_element *zr, unsigned char scalar[32], const field_element precomputed[65][4])
{
  field_element temp_result, temp_x, temp_y, temp_t, temp_z;
  unsigned char borrow;

  cli();
  borrow = scalar_sub_halforder(temp_result.Ed, scalar);
  sei();

  if (borrow == 0)
  {
    for (int i = 0; i < 32; i++){scalar[i] = temp_result.Ed[i];}

    windowed_scalar_mul(xr, yr, tr, zr, scalar, precomputed);

    cli();
    Ed255_subp_bigint(xr->Ed, xr->Ed);
    Ed255_subp_bigint(yr->Ed, yr->Ed);
    sei();
    return;
  }
  unsigned char window_value = (scalar[31] << 2) | (scalar[30] >> 6);
  memcpy_P(xr->Ed, precomputed[window_value][0].Ed, 32);
  memcpy_P(yr->Ed, precomputed[window_value][1].Ed, 32);
  memcpy_P(tr->Ed, precomputed[window_value][2].Ed, 32);
  memcpy_P(zr->Ed, precomputed[window_value][3].Ed, 32);

  for (int j = 5; j >= 0; j--) {double_point(xr, yr, tr, zr);}

  window_value = scalar[30] & 0x3F;

  memcpy_P(temp_x.Ed, precomputed[window_value][0].Ed, 32);
  memcpy_P(temp_y.Ed, precomputed[window_value][1].Ed, 32);
  memcpy_P(temp_t.Ed, precomputed[window_value][2].Ed, 32);
  memcpy_P(temp_z.Ed, precomputed[window_value][3].Ed, 32);

  add_points(xr, yr, tr, zr, &temp_x, &temp_y, &temp_t, &temp_z);

  for (int i = 9; i >= 0; i--)
  {
    for (int j = 5; j >= 0; j--) {double_point(xr, yr, tr, zr);}

    window_value = scalar[(i*3)+2] >> 2;   

    memcpy_P(temp_x.Ed, precomputed[window_value][0].Ed, 32);
    memcpy_P(temp_y.Ed, precomputed[window_value][1].Ed, 32);
    memcpy_P(temp_t.Ed, precomputed[window_value][2].Ed, 32);
    memcpy_P(temp_z.Ed, precomputed[window_value][3].Ed, 32);

    add_points(xr, yr, tr, zr, &temp_x, &temp_y, &temp_t, &temp_z);

    for (int j = 5; j >= 0; j--) {double_point(xr, yr, tr, zr);}

    window_value = ((scalar[(i*3)+2] & 0x03) << 4) | (scalar[(i*3)+1] >> 4);

    memcpy_P(temp_x.Ed, precomputed[window_value][0].Ed, 32);
    memcpy_P(temp_y.Ed, precomputed[window_value][1].Ed, 32);
    memcpy_P(temp_t.Ed, precomputed[window_value][2].Ed, 32);
    memcpy_P(temp_z.Ed, precomputed[window_value][3].Ed, 32);

    add_points(xr, yr, tr, zr, &temp_x, &temp_y, &temp_t, &temp_z);

    for (int j = 5; j >= 0; j--) {double_point(xr, yr, tr, zr);}

    window_value = ((scalar[(i*3)+1] & 0x0F)<<2) | (scalar[i*3]>>6);

    memcpy_P(temp_x.Ed, precomputed[window_value][0].Ed, 32);
    memcpy_P(temp_y.Ed, precomputed[window_value][1].Ed, 32);
    memcpy_P(temp_t.Ed, precomputed[window_value][2].Ed, 32);
    memcpy_P(temp_z.Ed, precomputed[window_value][3].Ed, 32);

    add_points(xr, yr, tr, zr, &temp_x, &temp_y, &temp_t, &temp_z);

    for (int j = 5; j >= 0; j--) {double_point(xr, yr, tr, zr);}

    //step 4. 5th window --> scalar[27] & 3F
    window_value = scalar[i*3] & 0x3F;

    memcpy_P(temp_x.Ed, precomputed[window_value][0].Ed, 32);
    memcpy_P(temp_y.Ed, precomputed[window_value][1].Ed, 32);
    memcpy_P(temp_t.Ed, precomputed[window_value][2].Ed, 32);
    memcpy_P(temp_z.Ed, precomputed[window_value][3].Ed, 32);

    add_points(xr, yr, tr, zr, &temp_x, &temp_y, &temp_t, &temp_z);
  }

  M_Inverse_Z(zr, zr);
  mul(xr, xr, zr);
  in_range(xr);
}

void double_point(field_element *xr, field_element *yr, field_element *tr, field_element *zr)
{
  field_element A, B, C, D, E, F, G, H;
  square(&A, xr);
  square(&B, yr);
  square(&C, zr);
  add(&C, &C, &C);
  sub(&D, &prime, &A);
  add(&E, xr, yr);
  square(&E, &E);
  sub(&E, &E, &A);
  sub(&E, &E, &B);
  add(&G, &D, &B);
  sub(&F, &G, &C);
  sub(&H, &D, &B);
  mul(xr, &E, &F);
  mul(yr, &G, &H);
  mul(tr, &E, &H);
  mul(zr, &F, &G);
}

void add_points(field_element *xr, field_element *yr, field_element *tr, field_element *zr, const field_element *px, const field_element *py, const field_element *tz, const field_element *pz)
{
    field_element A, B, C, D, E, F, G, H;
    sub(&A, yr, xr);
    add(&B, py, px);
    mul(&A, &A, &B);
    add(&B, yr, xr);
    sub(&C, py, px);
    mul(&B, &B, &C);
    mul(&C, zr, tz);
    add(&C, &C, &C);
    mul(&D, tr, pz);
    add(&D, &D, &D);
    add(&E, &D, &C);
    sub(&F, &B, &A);
    add(&G, &B, &A);
    sub(&H, &D, &C);
    mul(xr, &E, &F);
    mul(yr, &G, &H);
    mul(tr, &E, &H);
    mul(zr, &F, &G);
}

void M_Inverse_Z(field_element *r, const field_element *x)
{
  field_element z2;
  field_element z11;
  field_element z2_10_0;
  field_element z2_50_0;
  field_element z2_100_0;
  field_element t0;
  field_element t1;
  unsigned char i;

  square(&z2,x);
  square(&t1,&z2);
  square(&t0,&t1);
  mul(&z2_10_0,&t0,x);
  mul(&z11,&z2_10_0,&z2);
  square(&t0,&z11);
  mul(&z2_10_0,&t0,&z2_10_0);
  square(&t0,&z2_10_0);
  square(&t1,&t0);
  square(&t0,&t1);
  square(&t1,&t0);
  square(&t0,&t1);
  mul(&z2_10_0,&t0,&z2_10_0);
  square(&t0,&z2_10_0);
  square(&t1,&t0);
  for (i = 2;i < 10;i += 2){ square(&t0,&t1); square(&t1,&t0); }
  mul(&z2_50_0,&t1,&z2_10_0);
  square(&t0,&z2_50_0);
  square(&t1,&t0);
  for (i = 2;i < 20;i += 2) { square(&t0,&t1); square(&t1,&t0); }
  mul(&t0,&t1,&z2_50_0);
  square(&t1,&t0);
  square(&t0,&t1);
  for (i = 2;i < 10;i += 2) { square(&t1,&t0); square(&t0,&t1); }
  mul(&z2_50_0,&t0,&z2_10_0);
  square(&t0,&z2_50_0);
  square(&t1,&t0);
  for (i = 2;i < 50;i += 2) { square(&t0,&t1); square(&t1,&t0); }
  mul(&z2_100_0,&t1,&z2_50_0);
  square(&t1,&z2_100_0);
  square(&t0,&t1);
  for (i = 2;i < 100;i += 2) { square(&t1,&t0); square(&t0,&t1); }
  mul(&t1,&t0,&z2_100_0);
  square(&t0,&t1);
  square(&t1,&t0);
  for (i = 2;i < 50;i += 2) { square(&t0,&t1); square(&t1,&t0); }
  mul(&t0,&t1,&z2_50_0);
  square(&t1,&t0);
  square(&t0,&t1);
  square(&t1,&t0);
  square(&t0,&t1);
  square(&t1,&t0);
  mul(r,&t1,&z11);
}

void in_range(field_element *r)
{
  unsigned char bwr;
  field_element temp_result;
  bwr = Ed_num_sub_prime(temp_result.Ed, r->Ed);
  flip_if(r,&temp_result,1-bwr);
}

void flip_if(field_element *r, const field_element *x, unsigned char b)
{
  unsigned char i;
  unsigned long mask = b;
  mask = -mask;
  for(i=0;i<32;i++)
  {
    r->Ed[i] ^= mask & (x->Ed[i] ^ r->Ed[i]);
  }
}

void mul(field_element *r, const field_element *x, const field_element *y)
{
  unsigned char t[64];
  cli();
  Ed_mul(t,x->Ed,y->Ed);
  sei();
  modulo(r,t);
}

void square(field_element *r, const field_element *x)
{
  unsigned char t[64];
  cli();
  Ed25519_square(t,x->Ed);
  sei();
  modulo(r,t);
}

void Ed25519_scalar_sub_order(field_element *r)
{
  unsigned char bwr;
  field_element tempResult;
  cli();
  bwr = scalar_sub_order(tempResult.Ed, r->Ed);
  sei();
  flip_if(r,&tempResult,1-bwr);
}